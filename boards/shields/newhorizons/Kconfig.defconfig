## boards/shields/newhorizons/Kconfig.defconfig
```kconfig
# Copyright (c) 2025 The ZMK Contributors
# SPDX-License-Identifier: MIT

if SHIELD_NEWHORIZONS

config ZMK_KEYBOARD_NAME
    default "New Horizons"

endif
```
